## xilinx-yocto/conf/bblayers.conf
```bitbake
# LAYER_CONF_VERSION is increased each time build/conf/bblayers.conf
# changes incompatibly
LCONF_VERSION = "6"

BBPATH = "${TOPDIR}"
BBFILES ?= ""

BBLAYERS ?= " \
  /home/mohammed/poky-daisy/meta \
  /home/mohammed/poky-daisy/meta-yocto \
  /home/mohammed/poky-daisy/meta-yocto-bsp \
  /home/mohammed/poky-daisy/meta-xilinx \
  /home/mohammed/poky-daisy/meta-sdr-dpr \
  /home/mohammed/poky-daisy/meta-sdr \
  /home/mohammed/poky-daisy/meta-openembedded/meta-python \
  /home/mohammed/poky-daisy/meta-openembedded/meta-networking \
  /home/mohammed/poky-daisy/meta-openembedded/meta-filesystems \
  /home/mohammed/poky-daisy/meta-openembedded/meta-oe \
  "
BBLAYERS_NON_REMOVABLE ?= " \
  /home/mohammed/poky-daisy/meta \
  /home/mohammed/poky-daisy/meta-yocto \
  "
```

## xilinx-yocto/meta-sdr-dpr/conf/layer.conf
```bitbake
# We have a conf and classes directory, add to BBPATH
BBPATH .= ":${LAYERDIR}"

# We have recipes-* directories, add to BBFILES
BBFILES += "${LAYERDIR}/recipes-*/*/*.bb \
	${LAYERDIR}/recipes-*/*/*.bbappend"

BBFILE_COLLECTIONS += "sdr-dpr"
BBFILE_PATTERN_sdr-dpr = "^${LAYERDIR}/"
BBFILE_PRIORITY_sdr-dpr = "6"
```
